## conf/layer.conf
```bitbake
BBPATH .= ":${LAYERDIR}"

BBFILES += "${LAYERDIR}/recipes-*/*/*.bb \
            ${LAYERDIR}/recipes-*/*/*.bbappend"

BBFILE_COLLECTIONS += "meta-de0nano-litex"
BBFILE_PATTERN_meta-de0nano-litex = "^${LAYERDIR}/"
BBFILE_PRIORITY_meta-de0nano-litex = "6"

LAYERDEPENDS_meta-de0nano-litex = "core"
LAYERSERIES_COMPAT_meta-de0nano-litex = "scarthgap"
```

## conf/machine/de0nano-litex.conf
```bitbake
#@TYPE: Machine
#@NAME: de0nano-litex
#@DESCRIPTION: LiteX VexRISCV on DE0-Nano

# Arquitectura
require conf/machine/include/riscv/tune-riscv.inc
DEFAULTTUNE = "riscv32"
# Aclaramos las flags para que se compilen todas instrucciones válidas
TARGET_CC_ARCH = "-march=rv32ima -mabi=ilp32"
TUNE_CCARGS = "-march=rv32ima -mabi=ilp32"

# Bootloader
# No hace falta, la BIOS de Litex cumple ese rol
PREFERRED_PROVIDER_virtual/bootloader = ""
EXTRA_IMAGEDEPENDS:remove = "virtual/bootloader opensbi"
RISCV_SBI_PLAT = ""
RISCV_SBI_FDT = ""

# Kernel
PREFERRED_PROVIDER_virtual/kernel = "linux-litex"
PREFERRED_VERSION_linux-litex = "6.9%"
KERNEL_IMAGETYPE = "Image"
KERNEL_DEVICETREE = "litex/de0nano.dtb"

# UART, la que usa Litex
SERIAL_CONSOLES = "115200;ttyLXU0"

# Filesystem
IMAGE_FSTYPES = "cpio.gz"
WKS_FILE = ""

# Extras
MACHINE_FEATURES = "serial"
MACHINE_ESSENTIAL_EXTRA_RDEPENDS = ""
MACHINE_ESSENTIAL_EXTRA_RRECOMMENDS = ""
```
